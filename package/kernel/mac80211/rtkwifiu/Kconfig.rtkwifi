## package/kernel/mac80211/rtkwifiu/Kconfig.rtkwifi
```kconfig
config RTKWIFIU
	tristate "Realtek USB Wireless Cards"
	depends on m
	depends on CFG80211

if RTKWIFIU

source "drivers/net/wireless/realtek/rtkwifiu/rtl8822cs/Kconfig"
source "drivers/net/wireless/realtek/rtkwifiu/rtl8852be/Kconfig"
source "drivers/net/wireless/realtek/rtkwifiu/rtl8852bs/Kconfig"

endif
```

## package/realtek/rtk-bluecore/Config.in
```kconfig
menu "rtk-bluecore Configuration"
	depends on PACKAGE_rtk-bluecore

config UPDATE_AUDIO_FW
	bool "Update audio FW"
	default n
	help
	  Sync to latest build from rtk-dl.

endmenu
```

## target/linux/rtd1xxx/files-5.10/Documentation/devicetree/bindings/clock/realtek,clocks.txt
```
Realtek Clock/Reset Controller
==============================

Clock/Reset controllers for Realtek Platform

Platform Controllers
--------------------

These device tree node should be placed in a syscon.

Required properties :

- compatible :
	should contain only one of the following:

		"realtek,rtd1195-crt-clk" for RTD1195 CRT clock controller,
		"realtek,rtd1195-iso-clk" for RTD1195 ISO clock controller,
		"realtek,rtd1295-crt-clk" for RTD1295 CRT clock controller,
		"realtek,rtd1295-iso-clk" for RTD1295 ISO clock controller,
		"realtek,rtd1395-crt-clk" for RTD1395 CRT clock controller,
		"realtek,rtd1395-iso-clk" for RTD1395 ISO clock controller,
		"realtek,rtd1619-crt-clk" for RTD1619 CRT clock controller,
		"realtek,rtd1611-crt-clk" for RTD1611 CRT clock controller,
		"realtek,rtd1619-iso-clk" for RTD1619 ISO clock controller,
		"realtek,rtd1319-crt-clk" for RTD1319 CRT clock controller,
		"realtek,rtd1319-crt-clk-n" for RTD1319 CRT clock controller of non-protected clocks,
		"realtek,rtd1311-crt-clk" for RTD1311 CRT clock controller,
		"realtek,rtd1319-iso-clk" for RTD1319 ISO clock controller,
		"realtek,rtd1619b-crt-clk" for RTD1319 CRT clock controller,
		"realtek,rtd1619b-crt-clk-n" for RTD1319 CRT clock controller of non-protected clocks,
		"realtek,rtd1619b-iso-clk" for RTD1319 ISO clock controller,
		"realtek,rtd1312c-crt-clk" for RTD1312C CRT clock controller,
		"realtek,rtd1312c-crt-clk-n" for RTD1312C CRT clock controller of non-protected clocks,
		"realtek,rtd1319d-crt-clk" for RTD1319D CRT clock controller,
		"realtek,rtd1319d-iso-clk" for RTD1319D ISO clock controller.


- #clock-cells : should be 1.

- #reset-cells : should be 1.

Example:

	syscon@98000000 {
		...

		cc: clock-controller {
			compatible = "realtek,rtd1295-cc";
			#clock-cells = <1>;
			#reset-cells = <1>;
		};
	};

	consumer {
		clocks = <&cc CC_CKE_GSPI>;
	};


TEE Clock Controller
--------------------

Required properties :

- compatible : 
	should contain only one of the following:

		"realtek,tee-clock-controller" for TEE Clock Controller


- #clock-cells : should be 0.

Example:

	tcc: tee-clocks {
		compatible = "realtek,tee-clock-controller";
		#clock-cells = <0>;
	};


See "clock-bindings.txt"
```

## target/linux/rtd1xxx/files-5.10/Documentation/devicetree/bindings/iio/adc/realtek,rtk-lsadc.txt
```
Realtek Low-speed Analog to Digital Converter

This LSADC has 2 pads with 6-bits resolution for 0 ~ 3.3V.

Required properties:
- compatible: should be one of
    "realtek,rtk-lsadc0"
    "realtek,rtk-lsadc"
- interrupt-parent: phandle to the parent interrupt controller
    see: Documentation/devicetree/bindings/interrupt-controller/interrupts.txt
- interrupts: IRQ line for the LSADC
- reg: Offset and length of the LSADC block register set.
- clk_gating_en: clock gating for LSADC is used for power saving.
    0: disable
    1: enable
- clocks: Clock used for this block.
- resets: phandle to reset this block.

Sub-nodes:
Each LSADC pad is configured as a subnode.

Required properties for subnodes:
- activate: 0:in-activate, 1:activate
- ctrl_mode: 0:voltage mode, 1:current mode
- sw_idx: 0:External input pin 0, 1:External input pin 1
- voltage_threshold: voltage threshold to trigger interrupt
- adc_val_baseline: absolute baseline to reset adc_val


Example node:

	lsadc@7900 {
		compatible = "realtek,rtk-lsadc0";
		interrupt-parent =  <&iso_irq_mux>;
		interrupts = <3>;
		reg = <0x7900 0x200>,
		      <0x34c 0x4>;
		clk_gating_en = <1>;
		clocks = <&ic IC_CKE_LSADC_ECOA2>;
		resets = <&ic IC_RSTN_LSADC_ECOA2>;
		lsadc0-pad0 {
			activate = <1>;
			ctrl_mode = <0>;
			sw_idx = <0>;
			voltage_threshold = <32>;
			adc_val_baseline = <63>;
		};

		lsadc0-pad1 {
			activate = <0>;
			ctrl_mode = <0>;
			sw_idx = <1>;
			voltage_threshold = <63>;
			adc_val_baseline = <63>;
		};
	};
```

## target/linux/rtd1xxx/files-5.10/Documentation/devicetree/bindings/interrupt-controller/realtek,intc.txt
```
Realrek Interrupt Controller

Required properties:

- compatible : "realtek,rtd13xx-iso-irq-mux" for rtd1319 SoCs
               "realtek,rtd13xx-misc-irq-mux" for rtd1319 SoCs
               "realtek,rtd16xxb-iso-irq-mux" for rtd1619b SoCs
               "realtek,rtd16xxb-misc-irq-mux" for rtd1619b SoCs

Example:

iso_irq_mux: iso_irq_mux {
	compatible = "realtek,rtd13xx-iso-irq-mux";
	syscon = <&iso>;
	interrupts = <GIC_SPI 41 IRQ_TYPE_LEVEL_HIGH>;
	interrupt-controller;
	#interrupt-cells = <1>;
};
```

## target/linux/rtd1xxx/files-5.10/Documentation/devicetree/bindings/mfd/apw888x.txt
```
Anpec APW888X series PMIC DT-bindings

Required properties:

* compatible: shall contains one of the following
	 "anpec,apw8889",
	 "anpec,apw8886", or
	 "anpec,apw7899".


=====================================

Anpec APW888X serise PMIC contains the following sub devices:
	g22xx-powerkey,
	apw8889-regulator for Anpec APW8889,
	apw8886-regulator for Anper APW8886.

Sub nodes:

regulators
----------

Required properties:

* compatible: shall contains one of the following
	"anpec,apw8889-regulator",
	"anpec,apw8886-regulator".

See also Documentation/devicetree/bindings/regulator/regulator.txt.

Properties for sub nodes

Optional properties:

* apw888x-discharge-disable: disable discharge when suspend state is configured
	to regulator-off-in-suspend in the sub nodes
	regulator-state-mem/regulator-state-coldboot.

Example:

	&i2c_0 {
		status = "okay";

		apw8889: apw8889@12 {
			compatible = "anpec,apw8889";
			reg = <0x12>;
			status = "okay";

			regulators: regulators {
				compatible = "anpec,apw8889-regulator";
				status = "okay";
			};
		};
	};
```

## target/linux/rtd1xxx/files-5.10/Documentation/devicetree/bindings/net/realtek,r8169soc.txt
```
Realtek r8169soc Ethernet driver

Required properties:
- compatible: should be one of below strings
  "realtek,rtd119x-r8169soc" for Phoenix (RTD1195) SoC
  "realtek,rtd129x-r8169soc" for Kylin (RTD1293, RTD1295, RTD1296) SoC
  "realtek,rtd139x-r8169soc" for Hercules (RTD1395) SoC
  "realtek,rtd16xx-r8169soc" for Thor (RTD1619) SoC
  "realtek,rtd13xx-r8169soc" for Hank (RTD1319) SoC
  "realtek,rtd16xxb-r8169soc" for Stark (RTD1619B) SoC
  "realtek,rtd13xxd-r8169soc" for Parker (RTD1319D) SoC
- reg: Address and length of the register set for the device
- interrupts:  Should contain the MAC interrupts
- pinctrl-names: names of pinmux set of corresponding output mode
- pinctrl-0: the default pinmux set
- local-mac-address: See ethernet-controller.yaml in the same directory.
  This property is overwrited by bootloader.
- output-mode: 0:embedded PHY (default),
  1:RGMII to MAC (valid for RTD1295, and RTD1319),
  2:RGMII to PHY (valid for RTD1319),
  3:SGMII to MAC (valid for RTD1395, and RTD1619),
  4:SGMII to PHY (valid for RTD1395, and RTD1619),
  5:RMII (valid for RTD1319),
  6:forced link (valid for RTD1319)
- acp: support ACP (Accelerator Coherence Port) or not
- eee: support EEE (Energy-Efficient Ethernet) or not
- clocks: Must contain a handle for each entry in clock-names.
- clock-names: The name of the clock listed in the clocks property.
- resets: Must contain a handle for each entry in reset-names.
- reset-names: The name of the reset listed in the resets property.

Optional properties:
- bypass: valid for RTD1395
  1: ETN MAC bypasses efuse update flow. SW needs to take this sequence.
  0: ETN MAC sets efuse update and efuse_rdy setting
- wol-enable: enable WoL or not
  BIT 0: WoL enable
  BIT 1: CRC match (up to 16 match patterns)
  BIT 2: WPD (Wake Packet Detection)
- led-cfg: customized LED setting
- pinctrl-1: the extra pinmux set of of corresponding output mode
- ext-phy-id: 0 ~ 31, only valid when output-mode = "SGMII to PHY"
- sgmii-swing: 0:640mV, 1:380mV, 2:250mV, 3:190mV,
  only valid when output-mode = "SGMII to MAC" or "SGMII to PHY"
- voltage: 1:1.8V, 2:2.5V, 3: 3.3V;
  only valid when output-mode = "RGMII to MAC", "RGMII to PHY", or "RMII"
- tx-delay: 0:0ns, 1:2ns;
  only valid when output-mode = "RGMII to MAC", "RGMII to PHY", or "RMII"
- rx-delay: 0:0ns, 1:2ns;
  only valid when output-mode = "RGMII to MAC", "RGMII to PHY", or "RMII"
- force-Gb-off: disable gigabit feature if defined
- wake-mask[0-15]: pattern mask of a packet (for WoL via CRC match)
- wake-crc[0-15]: CRC value of a masked packet (for WoL via CRC match)
- wake-mask[0-31]: pattern mask of a packet (for WoL via exactly pattern match)
- wake-crc[0-31]: CRC value of a masked packet (for WoL via exactly pattern match)
- wake-pattern[0-31]: pattern content for corresponding masked bytes (for WoL via exactly pattern match)
- wake-offset[0-31]: start offset of pattern (for WoL via exactly pattern match)
```

## target/linux/rtd1xxx/files-5.10/Documentation/devicetree/bindings/nvmem/rtk-efuse.txt
```
Realtek eFuse DT-bindings
=========================

See also 'Documentation/devicetree/bindings/nvmem/nvmem.txt'

Requried properties :
- compatible : shall contain one of the followings :
	"realtek,efuse",
	"realtek,rtd1619-otp"

Optional properties:
- realtek,sb2-lock : a hw lock for synchronization
```

## target/linux/rtd1xxx/files-5.10/Documentation/devicetree/bindings/power/reset/regmap-poweroff.txt
```
Simple Regmap Poweroff
======================

This is a simple regmap poweroff driver, which gets regmap from the parent
device and sets a register with value.

Required properties:
- compatible: should contain "regmap-poweroff"
- poweroff,offset: offset in the register map for the poweroff register
- poweroff,mask: the mask written to the poweroff register
- poweroff,value the value written to the poweroff register

Optional properties:
- system-power-controller: to indicate pm_power_off is set by this device.
  See also ../power-controller.txt

Examples:

	parent {

	        poweroff {
			compatible = "regmap-poweroff";
			poweroff,offset = <0x04>;
			poweroff,mask   = <0x80>;
			poweroff,value   = <0x80>
			system-power-controller;
		};
	};
```

## target/linux/rtd1xxx/files-5.10/Documentation/devicetree/bindings/power/reset/rtk,reboot-mode.txt
```
Realtek reboot mode driver

Required propertise:

- compatible: should contain "realtek,reboot-mode".

- reg: register to fill reboot command

Exmaple:

	reboot-mode {
		compatible = "realtek,reboot-mode";
		reg = <0x0 0x98007640 0x0 0x4>;
		status = "okay";
	};
```

## target/linux/rtd1xxx/files-5.10/Documentation/devicetree/bindings/power/reset/rtk,reboot.txt
```
Realtek reboot driver

Required properties:

- compatible: should be "realtek,reboot"

Optional properties:

- rst-oe: an unsigned int for value of oe to be configured

- rst-oe-for-init: an unsigned int for init value of oe

Example:
        reboot {
		compatible = "realtek,reboot";
		rst-oe = <0>;
		rst-oe-for-init = <1>;
		status = "okay";
	};
```

## target/linux/rtd1xxx/files-5.10/Documentation/devicetree/bindings/pwm/realtek,rtk-pwm.txt
```
Realtek PWM controller

This PWM controller provides 4 PWM outputs as sub-nodes and each one can be
enabled individually.
Required properties:
- compatible: should be one of below strings
  "realtek,rtk-pwm" for PWM V1 mode (rtd129x, rtd139x, rtd16xx, rtd13xx, rtd16xxb)
  "realtek,rtk-pwm-v2" for PWM V2 mode (rtd1312c)
- #pwm-cells: should be 2. See pwm.yaml in this directory for a description
  of the cells format
- reg: physical base address and length for this controller

Required properties of each sub-node:
- enable: turn on/off this PWM output
- clkout_div: PWM output clock divisor.
- clksrc_div: PWM clock source divisor.
- duty_rate: crest-to-trough ratio of this PWM output
```

## target/linux/rtd1xxx/files-5.10/Documentation/devicetree/bindings/reserved-memory/realtek,shared-memory.txt
```
* Realtek DHC platforms reserved-memory binding

- compatible:
	compatible = "ringbuf", "audio_heap", "media_heap";
```

## target/linux/rtd1xxx/files-5.10/Documentation/devicetree/bindings/reset/rtk-reset.txt
```
Realtek Reset Controller DT-bindings
------------------------------------

1. M2TMX reset controller

Required properties

- compatible: shall contain
		"realtek,rtd1319-m2tmx-reset".

- #reset-cells: shall be 1.

- realtek,m2tmx: shall contain a phandle to m2tmx syscon
```

## target/linux/rtd1xxx/files-5.10/Documentation/devicetree/bindings/rtc/rtc-rtk.txt
```
Realtek real time clock driver dt-bindings
==========================================

Required properties:
- compatible: must contains one of the following
		"realtek,rtd1195-rtc",
		"realtek,rtd1295-rtc",
		"realtek,rtd1619-rtc",
		"realtek,rtd1319-rtc".

- reg: contain the base of rtc register

- realtek,iso: a phandle to iso syscon

Optional properties:

- clocks: only required by rtd1195-rtc and rtd1295-rtc

- resets: only required by rtd1195-rtc

- rtc-base-year: should contain a integer for base year

- rtc-bias: should contain a integer for bias
```

## target/linux/rtd1xxx/files-5.10/Documentation/devicetree/bindings/rtc/rtc-sw.txt
```
Realtek Software-emulated Real-time Clock Driver DT-bindings
============================================================

Required properties:

* compatible: shoull be "realtek,emulated-rtc".
```

## target/linux/rtd1xxx/files-5.10/Documentation/devicetree/bindings/soc/realtek/bsv_ctrl.txt
```
Realtek BSV Controller for CPU DVFS dt-bindings
===============================================

Required properties:

- compatible: should be "realtek,bsv-controller".

- #clock-cells: should be 0.

- clocks: cpu clock

- cpu-supply: cpu supply

- nvmem-cells: bsv data in otp

- nvmem-cell-names: should be "bsv"


See regulator/regulator.yaml for regulator bindings.

Example:

/ {
        bsvc: bsv-ctrl {
                compatible = "realtek,bsv-controller";
                #clock-cells = <0>;
                regulator-name = "bsv_cpudvs";
                regulator-min-microvolt = <750000>;
                regulator-max-microvolt = <1200000>;
                regulator-boot-on;
                regulator-always-on;
                clocks = <&cc RTD1619B_CRT_PLL_SCPU>;
                cpu-supply = <&cpu_supp>;
                nvmem-cells = <&otp_bsv>;
                nvmem-cell-names = "bsv";
        };
};

&cpu0 {
        clocks = <&bsvc>;
        cpu-supply = <&bsvc>;
};

&cpu1 {
        clocks = <&bsvc>;
        cpu-supply = <&bsvc>;
};

&cpu2 {
        clocks = <&bsvc>;
        cpu-supply = <&bsvc>;
};

&cpu3 {
        clocks = <&bsvc>;
        cpu-supply = <&bsvc>;
};
```

## target/linux/rtd1xxx/files-5.10/Documentation/devicetree/bindings/soc/realtek/crt.txt
```
Realtek CRT Driver DT-binding document
======================================

Required properties:

- compatible: should contain "syscon", "simple-mfd" and one of the following,
	"realtek,rtd1295-crt",
	"realtek,rtd1395-crt",
	"realtek,rtd1619-crt",
	"realtek,rtd1319-crt".

- reg: address of CRT.

Example:

	crt: crt@98000000 {
		reg = <0x0 0x98000000 0x0 0x1000>;
		compatible = "realtek,rtd1319-crt", "syscon", "simple-mfd";
		ranges = <0x0 0x0 0x0 0x98000000 0x0 0x1000>;
		#address-cells = <2>;
		#size-cells = <2>;
	};
```
