## target/linux/rtd1xxx/files-5.10/Documentation/devicetree/bindings/soc/realtek/dbus_pmu.txt
```
Realtek Dbus (DC-SYS) PMU dt-bindings
=====================================

Required properties:
- compatible:
        "realtek,rtk-16xxb-dbus-pmu" for rtd16xxb family
- reg: address range of Dbus PMU

Optional properties:
- overflow: indicating the PMU has overflow interrupt

Performance Counters Subnode
----------------------------
Each subnode of Dbus PMU represents a set of PMC groups which has its own
counter groups and controlling mechanism, but will be enabled and disabled
together with Dbus PMU.

Required properties:
- compatible:
	"dbus-sysh"
	"dbus-sys"
	"dbus-ch"

Optional properties:
- nr_defects: the number of counters which may work incorrectly
- defects: array of the index of problematic counters

Example:

	dbus-pmu: rtk-dbus-pmu@8000 {
		compatible = "realtek,rtk-16xxb-dbus-pmu";
		#address-cells = <1>;
		#size-cells = <1>;
		reg = <0x0 0x8000 0x0 0x0d00>;
		overflow = <1>;

		dbus-sysh: dbus-sysh {
			nr_defects = <2>;
			defects = <1 3>;
		};

		dbus-sys: dbus-sys {
			nr_defects = <1>;
			defects = <0>;
		};
	};
```

## target/linux/rtd1xxx/files-5.10/Documentation/devicetree/bindings/soc/realtek/ddrc_pmu.txt
```
Realtek DDRC PMU dt-bindings
============================

Required properties:
- compatible:
        "realtek,rtk-16xxb-ddrc-pmu" for rtd16xxb family
- reg: address range of DDRC PMU

Optional properties:
- overflow: indicating the PMU has overflow interrupt

Performance Counters Subnode
----------------------------
Each subnode of DDRC PMU represents a set of PMC groups which has its own
counter groups and controlling mechanism, but will be enabled and disabled
together with DDRC PMU.

Required properties:
- compatible:
	"ddrc"
	"ddrc-total"
	"ddrc-log"

Optional properties:
- nr_defects: the number of counters which may work incorrectly
- defects: array of the index of problematic counters

Example:

	ddrc-pmu: rtk-ddrc-pmu@94000 {
		compatible = "realtek,rtk-16xxb-ddrc-pmu";
		#address-cells = <1>;
		#size-cells = <1>;
		reg = <0x0 0x94000 0x0 0x0800>;
		overflow = <1>;

		ddrc: ddrc {
			nr_defects = <2>;
			defects = <1 3>;
		};
	};
```

## target/linux/rtd1xxx/files-5.10/Documentation/devicetree/bindings/soc/realtek/gpc.txt
```
Realtek Generic Power Control DT-bindings
=========================================

Required Properties:

- compatible: should contain one of the following
	"realtek,rtd1295-ve1-power",
	"realtek,rtd1295-ve2-power",
	"realtek,rtd1295-ve3-power",
	"realtek,rtd1295-gpu-power",
	"realtek,rtd1295-nat-power",
	"realtek,rtd1395-ve1-power",
	"realtek,rtd1395-ve2-power",
	"realtek,rtd1395-gpu-power",
	"realtek,rtd1619-ve3-power",
	"realtek,rtd1619-gpu-power",
	"realtek,rtd1619-hdmirx-power",
	"realtek,rtd1319-ve1-power",
	"realtek,rtd1619b-npu-power",
	"realtek,rtd1619b-hifi0-power", and
	"realtek,rtd1619b-hifi1-power".

Optional Properties:

- resets: a list of reset control.

- reset-names: valid names are "reset", "bist", and "auto".

- clocks: a list of clocks.
```

## target/linux/rtd1xxx/files-5.10/Documentation/devicetree/bindings/soc/realtek/info.txt
```
Realtek Information provider DT-bindings
========================================

1. pll

required properties:

* compatible: should be one of the followings:
	"realtek,rtd139x-pll-info", or
	"realtek,rtd161x-pll-info", or
	"realtek,rtd161xb-pll-info".

* realtek,crt: a phandle to crt syscon.

* realtek,scpu-wrapper: a phandle to scpu wrapper syscon.
```

## target/linux/rtd1xxx/files-5.10/Documentation/devicetree/bindings/soc/realtek/rbus_pmu.txt
```
Realtek Rbus PMU dt-bindings
============================

Required properties:
- compatible:
        "realtek,rtk-16xxb-rbus-pmu" for rtd16xxb family
- reg: address range of Rbus PMU

Optional properties:
- overflow: indicating the PMU has overflow interrupt

Example:

	rbus-pmu: rtk-rbus-pmu@1af00 {
		compatible = "realtek,rtk-16xxb-rbus-pmu";
		#address-cells = <1>;
		#size-cells = <1>;
		reg = <0x0 0x1af00 0x0 0x0080>;
		overflow = <1>;
	};
```

## target/linux/rtd1xxx/files-5.10/Documentation/devicetree/bindings/soc/realtek/rxi316_pmu.txt
```
Realtek RXI-316 PMU dt-bindings
===============================

Required properties:
- compatible:
        "realtek,rtk-rxi316-pmu"
- reg: address range of RXI-316 PMU

Example:

	rxi316_pmu: rxi316-pmu@92000 {
		compatible = "realtek,rxi316-pmu";
		reg = <0x92000 0x0 0x1000>;
	};
```

## target/linux/rtd1xxx/files-5.10/Documentation/devicetree/bindings/soc/realtek/traffic_pmu.txt
```
Realtek Traffic PMU (TFC) dt-bindings
=====================================

Required properties:
- compatible:
        "realtek,rtk-16xxb-ddrc-tfc-pmu": monitoring traffic of each DDRC ports
	for rtd16xxb family.
- reg: address range of traffic PMU

Optional properties:
- overflow: indicating the PMU has overflow interrupt

Example:

	ddrc-tfc-pmu: rtk-ddrc-tfc-pmu@94400 {
		compatible = "realtek,rtk-16xxb-ddrc-tfc-pmu";
		#address-cells = <1>;
		#size-cells = <1>;
		reg = <0x0 0x94400 0x0 0x0200>;
		overflow = <1>;
	};
```
