// SPDX-License-Identifier: (GPL-2.0-or-later OR BSD-2-Clause)
/*
 * Copyright (c) 2019 Realtek Semiconductor Corp.
 */

/dts-v1/;

#include "rtd13xx-rescue.dtsi"

/ {
	model = "Realtek RTD1319 Rescue";

	memory@4000 {
		device_type = "memory";
		reg = <0x00004000 0x4fffc000>; /* 1 GiB */
	};

	chosen {
		bootargs = "earlycon=uart8250,mmio32,0x98007800 console=ttyS0,460800 init=/init androidboot.storage=emmc androidboot.hardware=hank";
	};
};

