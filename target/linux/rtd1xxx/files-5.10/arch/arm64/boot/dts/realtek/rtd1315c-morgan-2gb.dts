// SPDX-License-Identifier: (GPL-2.0-or-later OR BSD-2-Clause)
/*
 * Copyright (c) 2021 Realtek Semiconductor Corp.
 */

/dts-v1/;

#include "rtd1315c-morgan.dtsi"

/ {
	compatible = "realtek,morgan", "realtek,rtd1315c";
	model = "Realtek Morgan EVB (2GB DDR4)";

	memory@40000 {
		device_type = "memory";
		reg = <0x00040000 0x7ffc0000>; /* 2 GB */
	};

	chosen {
		bootargs = "earlycon=uart8250,mmio32,0x98007800 init=/init NO_RESERVE";
	};
};
