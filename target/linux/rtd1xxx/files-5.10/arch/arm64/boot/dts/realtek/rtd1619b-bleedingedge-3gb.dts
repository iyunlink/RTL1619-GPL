// SPDX-License-Identifier: (GPL-2.0-or-later OR BSD-2-Clause)
/*
 * Copyright (c) 2020-2021 Realtek Semiconductor Corp.
 */

/dts-v1/;

#include "rtd1619b-bleedingedge.dtsi"

/ {
	compatible = "realtek,bleeding-edge", "realtek,rtd1619b";
	model = "Realtek Bleeding Edge EVB (3GB)";

	memory@40000 {
		device_type = "memory";
		reg = <0x00040000 0x7ffc0000>,
		      <0x80020000 0x080e0000>,
		      <0x8a100000 0x0defc000>,
		      <0x98200000 0x27e00000>;
	};

	reserved-memory {
		pcie_reserved: pcie_reserved {
			size = <0x2000000>;
			alloc-ranges = <0xa0000000 0x02000000>;
			no-map;
		};
	};
};
