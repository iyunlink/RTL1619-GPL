## target/linux/rtd1xxx/files-5.10/drivers/soc/realtek/common/rpc/Kconfig
```kconfig
config REALTEK_RPC
	tristate "Realtek RPC driver"
	depends on REALTEK_SOC
	default y
	help
	  Realtek RPC driver.

config REALTEK_RPC_VE3
	tristate "Realtek VE3 RPC"
	depends on REALTEK_RPC
	help
	  Enable Realtek VE3 RPC.

config REALTEK_RPC_HIFI
	tristate "Realtek HIFI RPC"
	depends on REALTEK_RPC
	help
	  Enable Realtek HIFI RPC.

config RPC_KERN_VE2
	tristate "Realtek VE2 Intr RPC"
	depends on REALTEK_RPC
	help
	  Use Intr RPC in kernel for v4L2 feature.
```

## target/linux/rtd1xxx/files-5.10/drivers/soc/realtek/common/rtk_pd/Kconfig
```kconfig
menu "Realtek Power Domain"

config PD_REALTEK
	tristate "Realtek Power Domain Support"
	depends on PM
	depends on ARCH_REALTEK
	select PM_GENERIC_DOMAINS
	select RTK_PM_TRACE
	default y

endmenu
```

## target/linux/rtd1xxx/files-5.10/drivers/soc/realtek/common/rtk_scd/Kconfig
```kconfig
menu "Smart Crad Interface Support"

config SMARTCARD
	tristate "Smart Card Interface Support"
	default n
	help
	  Say Y here if you want to support smart card on your platform 
	
source "drivers/soc/realtek/common/rtk_scd/core/Kconfig"

source "drivers/soc/realtek/common/rtk_scd/adapter/Kconfig"

endmenu
	
```

## target/linux/rtd1xxx/files-5.10/drivers/soc/realtek/common/rtk_scd/core/Kconfig
```kconfig
# drivers/smartcard/core/Kconfig
	
config SMARTCARD_CHARDEV
	bool "Smart Card Device Interface"
	depends on SMARTCARD
	select SMARTCARD_DEV_FILE
	help
	  Say Y here to use smart card device files, usually found in the /dev/smartcard/
	  directory on your system.  They make it possible to have user-space
	  programs use the smart card reader.	  
	
config SMARTCARD_DEV_FILE	
	bool
	depends on SMARTCARD
	default n

config SMARTCARD_DEBUG
	bool "Smart Card Debug Mode"
	depends on SMARTCARD
	default n
	help 
	  If you want to enable smart card debug message, say Y.

config SMARTCARD_NX_ATR_TIMEOUT_CHECK
	bool "Smart Card ATR Timeout Check"
	depends on SMARTCARD
	default y
	help
	  If you want to enable ATR timeout check for Nagra talts/dal ICC scripts with CardSim, say Y.
```

## target/linux/rtd1xxx/files-5.10/drivers/thermal/realtek/Kconfig
```kconfig
config RTK_THERMAL
	tristate "Realtek thermal management"
	depends on OF && THERMAL_OF
	depends on ARCH_REALTEK || COMPILE_TEST
	default y
	help
	  Enable thermal management with a generic thermal
	  sensor driver on Realtek SoCs.

	  If you want this support, you should say Y here.

config RTK_THERMAL_CPU_CORE_COOLING
	tristate "Realtek CPU core cooling device"
	select RTK_CPUHP_QOS
	help
	This enable Realtek CPU core cooling device drvier

        If not sure, say N
```

## target/linux/rtd1xxx/files-5.10/sound/soc/realtek/Kconfig
```kconfig
config SND_SOC_REALTEK
	tristate "Realtek ALSA Driver"
	select SND_PCM
	select SND_SOC_COMPRESS
	default y

config SND_SOC_REALTEK_NOTIFY
	tristate "Realtek ALSA Notfiy Driver"
	depends on SND_SOC_REALTEK
	default y

config SND_SOC_REALTEK_FL3236
	tristate "REALTEK Feature for fl3236 light driver"
	default n
```

## target/linux/rtd1xxx/image/Config.in
```kconfig
menu "Realtek Image File Creator Options"

config RTK_FWDESC_ENABLE_SHA256
	bool "Enable SHA256 Check"
	depends on PACKAGE_rtk-imagefile
	help
	  Enable this option to verify sha256 of each image

config RTK_SECURE_BOOT
	bool "Enable Secure Boot"
	depends on PACKAGE_rtk-imagefile
	help
	  Enable this for secure boot (only for eMMC)

config RTK_SECURE_BOOT_ENCRYPT
	bool "Encrypt firmware for Secure Boot"
	depends on RTK_SECURE_BOOT
	help
	  Encrypt firmwares for secure boot

config RTK_SECURE_BOOT_EFUSE
	bool "Burn Out OTP"
	depends on RTK_SECURE_BOOT_ENCRYPT
	help
	  Please enable this once only. The 1st time you want to enabled secure boot.

config RTK_FORCE_SECURE_BOOT
	bool "Force Secure Boot without Burn OTP"
	depends on !RTK_SECURE_BOOT_EFUSE
	help
	  Turn on this option if you don't want to burn out the OTP while trying to enable secure boot.

config RTK_3RD_PARTY_ROOTFS
    bool "Use 3rd party OpenWrt rootfs"
    help
      Put your 3rd party OpenWrt rootfs in image folder and name it as realtek.tar.gz

config RTK_3RD_PARTY_EXT4_ROOTFS
    bool "Use 3rd party ext4 rootfs"
    depends on RTK_3RD_PARTY_ROOTFS
    select TARGET_ROOTFS_EXT4FS
    select TARGET_EXT4_BLOCKSIZE_4K
    help
      Put your 3rd party rootfs in image folder and name it as realtek.tar.gz

endmenu
```
