## target/linux/rtd1xxx/files-5.10/Documentation/devicetree/bindings/soc/realtek/wdt_st.txt
```
Realtek Watchdog Status Driver DT-bindings
==========================================

Required properties:

- reg: address and size of the device.

- compatible: shall be "realtek,rtd1619b-watchdog-status".


Example:
	watchdog5: watchdog-st@aa0 {
		reg = <0xaa0 0x20>;
		compatible = "realtek,rtd1619b-watchdog-status";
	};
```

## target/linux/rtd1xxx/files-5.10/Documentation/devicetree/bindings/sound/snd-realtek-notify.txt
```
Realtek Sound Pinmux Driver.

Required properties:
- compatible : "adc"
				"analog-in"
				"adc-amic"
				"earc-combo"
				"realtek,audio-in"
				"realtek,audio-out"
				"realtek,audio"
- reg : The register base for the controller.
- interrupts : One interrupt, used by the controller.
- #address-cells : <1>, as required by generic sound device binding.
- #size-cells : <0>, also as required by generic sound device binding.
- pinctrl-names : Names of pinmux set of corresponding output mode.
- pinctrl-0 : The default pinmux set.
- num-chipselect : The number of chipselects. It should be 1.
- bus-num : The bus number of this sound device controller.
- clock-frequency : The max. frequency of this sound device controller.
- clocks : phandles for the clocks
- resets : phandles for the resets

Child nodes as per the generic sound device binding.

Example:
```

## target/linux/rtd1xxx/files-5.10/Documentation/devicetree/bindings/sound/snd-realtek.txt
```
Realtek ALSA Driver.

Required properties:
- compatible : "realtek,rtk-alsa-pcm"
- reg : The register base for the clock enable.
- interrupts : One interrupt, used by the controller.
- #address-cells : <1>, as required by generic alsa binding.
- #size-cells : <0>, also as required by generic alsa binding.
- pinctrl-names : Names of pinmux set of corresponding output mode.
- pinctrl-0 : The default pinmux set.
- num-chipselect : The number of chipselects. It should be 1.
- bus-num : The bus number of this alsa controller.
- clock-frequency : The max. frequency of this alsa controller.
- clocks : phandles for the clocks
- resets : phandles for the resets

Child nodes as per the generic alsa binding.

Example:

	sound: sound@10 {
		compatible = "realtek,rtk-alsa-pcm";
		reg = <0x10 0x1000>; /* CLK_EN2 */
		realtek,refclk = <&refclk>;
		status = "okay";
	};
```

## target/linux/rtd1xxx/files-5.10/Documentation/devicetree/bindings/spi/spi-dw-rtk.txt
```
Realtek Synchronous Serial Interface based on DesignWare SPI core.

Required properties:
- compatible : "realtek,rtk-dw-apb-ssi"
- reg : The register base for the controller.
    The 1st one is for DW SPI core, and the 2nd one is for wrapper.
- interrupts : One interrupt, used by the controller.
- #address-cells : <1>, as required by generic SPI binding.
- #size-cells : <0>, also as required by generic SPI binding.
- pinctrl-names : Names of pinmux set of corresponding output mode.
- pinctrl-0 : The default pinmux set.
- num-chipselect : The number of chipselects. It should be 1.
- bus-num : The bus number of this SPI controller.
- clock-frequency : The max. frequency of this SPI controller.
- clocks : phandles for the clocks
- resets : phandles for the resets

Child nodes as per the generic SPI binding.

Example:

	spi_0: spi@1BD00 {
		compatible = "realtek,rtk-dw-apb-ssi";
		#address-cells = <1>;
		#size-cells = <0>;
		interrupt-parent = <&misc_irq_mux>;
		interrupts = <27>; /* SPI_INT */
		reg = <0x1BD00 0x100>, /* DW SPI */
		      <0x1B300 0x18>; /* SPI wrapper */
		pinctrl-names = "default";
		pinctrl-0 = <&gspi_pins_0>;
		num-chipselect = <1>;
		bus-num = <0>;
		clocks = <&cc CC_CKE_GSPI>;
		clock-frequency = <256000000>;
		resets = <&cc CC_RSTN_GSPI>;
	};
```

## target/linux/rtd1xxx/files-5.10/Documentation/devicetree/bindings/thermal/realtek-thermal.txt
```
Realtek Thermal Driver DT-bindings
==================================

* Sensor node
-------------
Required properties :
- compatible : shall contain one of the following :
	"realtek,rtd119x-thermal-sensor",
	"realtek,rtd129x-thermal-sensor",
	"realtek,rtd139x-thermal-sensor",
	"realtek,rtd161x-thermal-sensor",
	"realtek,rtd131x-thermal-sensor",
	"realtek,rtd1619b-thermal-sensor",
	"realtek,rtd1312c-thermal-sensor".

- #thermal-sensor-cells : shall contain 0.

Optional properties:
- eoh-restore-ms: shall contain a interger, lock-freq time in ms for eoh,
	only vaild if eoh configured.

See also 'Documentation/devicetree/bindings/thermal/thermal.txt'

Exmaple :
	cpu-tsensor {
		tible = "realtek,rtd129x-thermal-sensor";
		reg = <0x9801D150 0x1C>;
		#thermal-sensor-cells = <0>;
		
		status = "okay";
	};


* CPU Core cooling
------------------

Required properties :
- compatible : should be  "realtek,cpu-core-cooling"

- #cooling-cells : should be 2
```

## target/linux/rtd1xxx/files-5.10/Documentation/devicetree/bindings/watchdog/rtk-wdt.txt
```
Realtek watchdog DT-bindings
============================

Required properties:

- compatible : should be "realtek,watchdog".

- reg : should contains 1 or 2 base physical address and size of registers

   the first address/size is for watchdog registers,
   the second address/size is optional and for watchdog ov-rstb registers.


Optional properties:

- timeout-sec: contains the watchdog timeout in seconds

- restart_priority: contains a value for restart_priority

- ov-rstb-oe-init: initial value of ov-rstb-oe

- ov-rstb-oe: value of ov-rstb-oe to be set during reboot 

Example:

	watchdog@10000000 {
		compatible = "realtek,watchdog";
		reg = <0x10000000 0x100>;
		timeout-sec = <20>;
	};
```

## target/linux/rtd1xxx/files-5.10/drivers/clk/realtek/Kconfig
```kconfig
# SPDX-License-Identifier: GPL-2.0-only
menuconfig COMMON_CLK_REALTEK
	tristate "Clock driver for Realtek"
	depends on ARCH_REALTEK || COMPILE_TEST
	select RESET_CONTROLLER
	select MFD_SYSCON
	select RTK_PM_TRACE
	default y

if COMMON_CLK_REALTEK

config CLK_PLL_PSAUD
	bool

config CLK_PLL_DIF
	bool

config RTK_CLK_PLL_MMC
	bool

config COMMON_CLK_RTD1195
	tristate "RTD1195 Clock Controller"
	depends on COMMON_CLK_REALTEK
	default y
	help
	  Support for the clock controller on RTD1195

config COMMON_CLK_RTD1295
	tristate "RTD1295 Clock Controller"
	depends on COMMON_CLK_REALTEK
	default y
	help
	  Support for the clock controller on RTD1295

config COMMON_CLK_RTD1395
	tristate "RTD1395 Clock Controller"
	depends on COMMON_CLK_REALTEK
	select CLK_DET
	default y
	help
	  Support for the clock controller on RTD1395

config COMMON_CLK_RTD1619
	tristate "RTD1619 Clock Controller"
	depends on COMMON_CLK_REALTEK
	select CLK_PLL_PSAUD
	select CLK_PLL_DIF
	select RTK_CLK_PLL_MMC
	select CLK_DET
	default y
	help
	  Support for the clock controller on RTD1619

config COMMON_CLK_RTD1319
	tristate "RTD1319 Clock Controller"
	depends on COMMON_CLK_REALTEK
	select CLK_PLL_PSAUD
	select CLK_PLL_DIF
	select RTK_CLK_PLL_MMC
	select CLK_DET
	default y
	help
	  Support for the clock controller on RTD1319

config COMMON_CLK_RTD1619B
	tristate "RTD1619B Clock Controller"
	depends on COMMON_CLK_REALTEK
	select CLK_PLL_PSAUD
	select CLK_PLL_DIF
	select RTK_CLK_PLL_MMC
	select CLK_DET
	default y
	help
	  Support for the clock controller on RTD1619B

config COMMON_CLK_RTD1319D
	tristate "RTD1319D Clock Controller"
	depends on COMMON_CLK_REALTEK
	select CLK_PLL_PSAUD
	select RTK_CLK_PLL_MMC
	select CLK_DET
	default y
	help
	  Support for the clock controller on RTD1319D

config COMMON_CLK_REALTEK_TEE
	tristate "Clock Driver to Control PLL SCPU over TEE"
	depends on TEE
	depends on COMMON_CLK_REALTEK
	default y
	help
	  PLL BUS/DCSB would be fixed when enable this.

config CLK_DET
	tristate "Clock Detection Support"
	depends on COMMON_CLK_REALTEK
	default y
	help
	  This enables clock detection support.

endif
```

## target/linux/rtd1xxx/files-5.10/drivers/gpu/drm/realtek/Kconfig
```kconfig
config DRM_RTK
	tristate "DRM Support for Realtek SoCs"
	depends on DRM
	help
	  Choose this option if you have a Realtek SoCs.
	  The module will be called realtek-drm
	  This driver provides kernel mode setting and
	  buffer management to userspace.
```

## target/linux/rtd1xxx/files-5.10/drivers/media/platform/rtk-cec/Kconfig
```kconfig
config RTK_HDMI_CEC
	tristate "Realtek HDMI CEC driver"
	select CEC_CORE
	select CEC_NOTIFIER
	help
	  This is a driver for Realtek HDMI CEC interface. It uses the
	  generic CEC framework interface.
	  CEC bus is present in the HDMI connector and enables communication
	  between compatible devices.
```

## target/linux/rtd1xxx/files-5.10/drivers/media/platform/rtk_dsi/Kconfig
```kconfig
#Copyright (C) 2007-2013 Realtek Semiconductor Corporation.
# drivers/Kconfig

config RTK_DSI
	bool "RTK DSI Support"
```

## target/linux/rtd1xxx/files-5.10/drivers/media/platform/rtk_hdcptx/Kconfig
```kconfig
config RTK_HDCP_1x
	tristate "HDCP TX 1.x for Realtek platform"
	select I2C
	select SWITCH
	select TEE
	default n
	help
	  Say Y, if you want to enable HDCP TX 1.x feature on Realtek platform.
```

## target/linux/rtd1xxx/files-5.10/drivers/media/platform/rtk_hdmitx/Kconfig
```kconfig
#Copyright (C) 2017 Realtek Semiconductor Corporation

config RTK_HDMITX
	tristate "HDMITX for Realtek platform"
	select I2C
	select SWITCH
	select RTK_HDMI_CEC
    select RTK_RPC
	default n
	help
	  Say Y, if you want to enable HDMITX feature on Realtek platform.

choice
	prompt "RTK HDMI model"
	depends on RTK_HDMITX
	default RTK_HDMI_RTD16XXB

config RTK_HDMI_RTD13XX
	bool "RTD13xx"

config RTK_HDMI_RTD16XXB
	bool "RTD16xxb"

endchoice
```

## target/linux/rtd1xxx/files-5.10/drivers/media/platform/rtk_tpdemux/Kconfig
```kconfig
config RTK_TPDEMUX
	tristate "Realtek TP FRONTEND DEMUX support"
	depends on PINCTRL && DVB_CORE && I2C
	help
	  This adds support for Realtek tp demux

choice
	prompt "Realtek tpdemux queue size"
	default RTK_TPDEMUX_QSIZE_256KB

config RTK_TPDEMUX_QSIZE_256KB
	bool "256kB"
	depends on RTK_TPDEMUX

config RTK_TPDEMUX_QSIZE_512KB
	bool "512kB"
	depends on RTK_TPDEMUX

config RTK_TPDEMUX_QSIZE_128KB
	bool "128kB"
	depends on RTK_TPDEMUX

config RTK_TPDEMUX_QSIZE_64KB
	bool "64kB"
	depends on RTK_TPDEMUX

endchoice
```

## target/linux/rtd1xxx/files-5.10/drivers/media/rc/rtk-ir/Kconfig
```kconfig
# SPDX-License-Identifier: GPL-2.0-only
config IR_RTK
	tristate "Realtek IR remote control"
	depends on RC_CORE
	help
	   Say Y if you want to use the IR remote control available
	   on REALTEK family SoCs.

	   To compile this driver as a module, choose M here: the
	   module will be called rtk-ir.

config IR_RTK_HW
	bool "Hardware decoder"
	depends on IR_RTK
	help
	   Say Y here to enable the hardware decode driver which decodes the IR
	   signals in hardware. This is more reliable, consumes less processing
	   power since only a single interrupt is received for each scancode,
	   and allows an IR scancode to be used as a wake event.

choice
	bool "HW decoder Selection"
	depends on IR_RTK_HW

config IR_RTK_HW_NEC
	bool "NEC protocol"

config IR_RTK_HW_RSTEP
	bool "RSTEP protocol"

config IR_RTK_HW_XMP
	bool "XMP protocol"

config IR_RTK_HW_SKY
	bool "SKY protocol"

endchoice

config IR_RTK_HW1
	bool "Seconde Hardware decoder"
	depends on IR_RTK
	help
	   Say Y here to enable the second hardware decode driver which decodes
	   the IR signals in hardware. This is more reliable, consumes less
	   processing power since only a single interrupt is received for each
	   scancode, and allows an IR scancode to be used as a wake event.

choice
	bool "HW1 decoder Selection"
	depends on IR_RTK_HW1

config IR_RTK_HW1_NEC
	bool "NEC protocol"

config IR_RTK_HW1_RSTEP
	bool "RSTEP protocol"

config IR_RTK_HW1_XMP
	bool "XMP protocol"

config IR_RTK_HW_SKY
	bool "SKY protocol"

endchoice

config IR_RTK_RAW
	bool "Raw decoder"
	depends on IR_RTK
	help
	   Say Y here to enable the raw mode driver which passes raw IR signal
	   changes to the IR raw decoders for software decoding. This is much
	   less reliable (due to lack of timestamps) and consumes more
	   processing power than using hardware decode, but can be useful for
	   testing, debug, and to make more protocols available.
```

## target/linux/rtd1xxx/files-5.10/drivers/perf/realtek/Kconfig
```kconfig
#
# Realtek SOC uncore PMU
#

menuconfig RTK_PMU
	bool "RTK PMU"
	depends on ARCH_REALTEK
	depends on PERF_EVENTS
	help
	  Enable Realtek SoC PMU.

if RTK_PMU

config RTK_DBUS_PMU
	tristate "DBUS PMU for Realtek"
	depends on RTK_PMU
	help
	  DBUS PMU driver for Realtek SoC

config RTK_DDRC_PMU
	tristate "PMU of DDRC"
	depends on RTK_PMU
	help
	  DDR controller PMU for Realtek SoC

config RTK_TFC_PMU
	tristate "PMU of DDRC"
	depends on RTK_PMU
	help
	  Traffic monitoring PMU for Realtek SoC

config RTK_RBUS_PMU
	tristate "PMU of Rbus"
	depends on RTK_PMU
	help
	  Register bus PMU for Realtek SoC

config RTK_RXI316_PMU
	tristate "Realtek RXI316 PMU"
	depends on RTK_PMU
	default n

config RTK_PMU_GATOR_COMPATIBLE
	bool "RTK PMU Gator Compatible"
	help
	  Gator use a pre-defined event config in opening perf event to determine the
	  existence of a PMU. The event config may be invalid for a RTK PMU. To workaround
	  this, the event config checking is postponed.

config RTK_PMU_DEV
	bool "RTK PMU Development"
	help
	  Additional checking of occurence of cornor cases.

config RTK_PMU_DEBUG
	bool "RTK PMU Debug"
	help
	  Message for debug RTK PMU

config RTK_PMU_TICK_REFRESH
	bool "Kick perf timer periodically"
	depends on NO_HZ_IDLE
	help
	  The perf tick may not work as expected if the scheduler is tickless, leading to
	  sampling throttled. This option kick the perf tick to ensure the sampling work
	  well.

endif # RTK PMU
```

## target/linux/rtd1xxx/files-5.10/drivers/phy/realtek/Kconfig
```kconfig
#
# Phy drivers for Realtek devices
#

config PHY_RTK_SATA
	tristate "Realtek SATA PHY driver"
	depends on OF
	select GENERIC_PHY
	help
	  Support for SATA GEN3 PHY on realtek chipsets.

config PHY_RTD_PCIE
	tristate "Realtek PCIe PHY driver"
	depends on OF
	select GENERIC_PHY
	help
	  Support for PCIe PHY on realtek chipsets.
```

## target/linux/rtd1xxx/files-5.10/drivers/soc/realtek/Kconfig
```kconfig
menu "Realtek SoC drivers"

config RTK_RESERVE_MEMORY
	bool "RTK Reserve Memory for Video/Image Codec"
	depends on ION
	default n

config RTK_PUWRAP
	tristate
	select RTK_RESERVE_MEMORY

config RTK_IMAGE_CODEC
	tristate "RTK Image Codec"
	select RTK_PUWRAP
	default y

menuconfig RTD13XX_RTK_CODEC
	tristate "Realtek RTD13XX Codec"
	select RTK_RESERVE_MEMORY
	default n
	help
	  Realtek RTD13XX codec support.

	  If unsure, say N.

config RTD13XX_VE1_CODEC
	tristate "RTK Video Engine 1 Codec"
	depends on RTD13XX_RTK_CODEC
	select RTK_PUWRAP
	default n

menuconfig RTD13XXD_RTK_CODEC
	tristate "Realtek RTD13XXD Codec"
	select RTK_RESERVE_MEMORY
	default n
	help
	  Realtek RTD13XXD codec support.

	  If unsure, say N.

config RTD13XXD_VE1_CODEC
	tristate "RTK Video Engine 1 Codec"
	depends on RTD13XXD_RTK_CODEC
	select RTK_PUWRAP
	default n

menuconfig RTD16XXB_RTK_CODEC
	tristate "Realtek RTD16XXB Codec"
	select RTK_RESERVE_MEMORY
	default n
	help
	  Realtek RTD16XXB codec support.

	  If unsure, say N.

config RTD16XXB_VE1_CODEC
	tristate "RTK Video Engine 1 Codec"
	depends on RTD16XXB_RTK_CODEC
	select RTK_PUWRAP
	default n

config REALTEK_SOC
	bool
	depends on ARCH_REALTEK
	default y
	help
	  Realtek SoC drivers.

	  If unsure, say N.

source "drivers/soc/realtek/common/Kconfig"
endmenu
```
